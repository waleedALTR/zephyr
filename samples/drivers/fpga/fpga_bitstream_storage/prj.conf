## CMakeLists.txt
```
# Copyright (c) 2026, Altera Corporation.
# SPDX-License-Identifier: Apache-2.0

cmake_minimum_required(VERSION 3.20.0)
find_package(Zephyr REQUIRED HINTS $ENV{ZEPHYR_BASE})
project(fpga_bitstream_storage)

target_sources(app PRIVATE src/main.c)

if(CONFIG_SAMPLE_FPGA_BITSTREAM_STORAGE_FLASH)
  # Only the image header layout is taken from the MCUboot module
  target_include_directories(app PRIVATE
    ${ZEPHYR_MCUBOOT_MODULE_DIR}/boot/bootutil/include
    ${ZEPHYR_MCUBOOT_MODULE_DIR}/boot/zephyr/include
  )
endif()
```

## Kconfig
```
# Copyright (c) 2026, Altera Corporation.
# SPDX-License-Identifier: Apache-2.0

choice SAMPLE_FPGA_BITSTREAM_STORAGE
	prompt "Storage the bitstream is read from"
	default SAMPLE_FPGA_BITSTREAM_STORAGE_FLASH
	help
	  Specify the type of storage the bitstream is read from.

config SAMPLE_FPGA_BITSTREAM_STORAGE_SDCARD
	bool "File on an SD card with a FAT file system"
	imply DISK_ACCESS
	imply DISK_DRIVER_SDMMC
	imply FILE_SYSTEM
	imply FAT_FILESYSTEM_ELM
	imply FS_FATFS_LFN
	help
	  Read the bitstream file from the FAT volume on the disk named SD,
	  mounted at /SD:.

config SAMPLE_FPGA_BITSTREAM_STORAGE_FLASH
	bool "MCUboot image in a flash partition"
	depends on ZEPHYR_MCUBOOT_MODULE
	select FLASH
	select FLASH_MAP
	help
	  Read the bitstream from the flash partition with the node label
	  slot1_partition, the slot MCUmgr uploads to. The partition holds
	  an MCUboot image as written by imgtool: a header with the
	  bitstream size, followed by the bitstream. The header layout comes
	  from the MCUboot module; MCUboot itself does not have to be the
	  bootloader.

endchoice

config SAMPLE_FPGA_BITSTREAM_FILE_NAME
	string "Bitstream file name"
	default "bitstream.bin"
	depends on !SAMPLE_FPGA_BITSTREAM_STORAGE_FLASH
	help
	  Name of the bitstream file in the root directory of the volume.

config SAMPLE_FPGA_BITSTREAM_MAX_SIZE
	int "Bitstream buffer size"
	default 4194304
	help
	  Size in bytes of the buffer that holds the bitstream while it is
	  loaded. A larger bitstream is rejected.

source "Kconfig.zephyr"
```

## sample.yaml
```
sample:
  name: FPGA bitstream storage
  description: Load an FPGA bitstream read from flash or from an SD card
common:
  tags:
    - fpga
  build_only: true
  platform_allow:
    - intel_socfpga_agilex5_socdk
  integration_platforms:
    - intel_socfpga_agilex5_socdk
tests:
  sample.drivers.fpga.bitstream_storage.flash: {}
  sample.drivers.fpga.bitstream_storage.sdcard:
    extra_configs:
      - CONFIG_SAMPLE_FPGA_BITSTREAM_STORAGE_SDCARD=y
```

## prj.conf
```kconfig
CONFIG_MAIN_STACK_SIZE=4096
CONFIG_FPGA=y
CONFIG_LOG=y
```

## boards/intel_socfpga_agilex5_socdk.conf
```kconfig
CONFIG_ALTERA_AGILEX_BRIDGE_FPGA=y
CONFIG_ARM_SIP_SVC_DRIVER=y
CONFIG_ARM_SIP_SVC_SUBSYS=y

CONFIG_FPGA_LOG_LEVEL_WRN=y
CONFIG_ARM_SIP_SVC_DRIVER_LOG_LEVEL_WRN=y
CONFIG_ARM_SIP_SVC_SUBSYS_LOG_LEVEL_WRN=y

# The FPGA driver and the SiP SVC subsystem allocate from the kernel heap
CONFIG_HEAP_MEM_POOL_SIZE=32768

# Upload the bitstream image to the bitstream partition with MCUmgr

# MCUmgr core
CONFIG_NET_BUF=y
CONFIG_ZCBOR=y
CONFIG_MCUMGR=y
CONFIG_MCUMGR_TRANSPORT_NETBUF_SIZE=4608

# SMP over the shell UART
CONFIG_SHELL=y
CONFIG_BASE64=y
CONFIG_CRC=y
CONFIG_MCUMGR_TRANSPORT_SHELL=y
CONFIG_MCUMGR_TRANSPORT_SHELL_MTU=4096
CONFIG_MCUMGR_TRANSPORT_SHELL_RX_BUF_COUNT=48
CONFIG_MCUMGR_TRANSPORT_SHELL_INPUT_TIMEOUT=y
CONFIG_SHELL_BACKEND_SERIAL_RX_RING_BUFFER_SIZE=1536

# Image management writes the image to the secondary slot
CONFIG_FLASH=y
CONFIG_FLASH_MAP=y
CONFIG_FLASH_PAGE_LAYOUT=y
CONFIG_STREAM_FLASH=y
CONFIG_IMG_MANAGER=y
CONFIG_MCUBOOT_IMG_MANAGER=y
CONFIG_IMG_ERASE_PROGRESSIVELY=y
CONFIG_MCUMGR_GRP_IMG=y

# "mcumgr reset" reboots, and the new bitstream is loaded at boot
CONFIG_REBOOT=y
CONFIG_MCUMGR_GRP_OS=y

# SMP commands and the flash writes run on the system work queue
CONFIG_SYSTEM_WORKQUEUE_STACK_SIZE=4096
```

## src/main.c
```c
/*
 * Copyright (c) 2026, Altera Corporation.
 * SPDX-License-Identifier: Apache-2.0
 */

#include <errno.h>
#include <stdint.h>

#include <zephyr/device.h>
#include <zephyr/drivers/fpga.h>
#include <zephyr/kernel.h>
#include <zephyr/logging/log.h>
#include <zephyr/sys/util.h>

LOG_MODULE_REGISTER(fpga_bitstream_storage, LOG_LEVEL_INF);

/* fpga_load() takes the whole bitstream as an array of 32-bit words */
static uint32_t bitstream[DIV_ROUND_UP(CONFIG_SAMPLE_FPGA_BITSTREAM_MAX_SIZE, sizeof(uint32_t))];

#if defined(CONFIG_SAMPLE_FPGA_BITSTREAM_STORAGE_FLASH)

#include <zephyr/storage/flash_map.h>
#include <zephyr/sys/byteorder.h>

#include <bootutil/image.h>

#define BITSTREAM_SOURCE "the bitstream partition"

/* Read the bitstream that follows the MCUboot image header. The image hash is not verified. */
static int bitstream_read(size_t *size)
{
	const struct flash_area *fa;
	struct image_header hdr;
	uint32_t hdr_size;
	uint32_t img_size = 0U;
	int ret;

	ret = flash_area_open(FIXED_PARTITION_ID(slot1_partition), &fa);
	if (ret != 0) {
		return ret;
	}

	ret = flash_area_read(fa, 0, &hdr, sizeof(hdr));
	if (ret == 0) {
		/* All header fields are little-endian */
		hdr_size = sys_le16_to_cpu(hdr.ih_hdr_size);
		img_size = sys_le32_to_cpu(hdr.ih_img_size);

		if ((sys_le32_to_cpu(hdr.ih_magic) != IMAGE_MAGIC) || (hdr_size < sizeof(hdr)) ||
		    (hdr_size > fa->fa_size) || (img_size > (fa->fa_size - hdr_size))) {
			ret = -ENOEXEC;
		} else if ((sys_le32_to_cpu(hdr.ih_flags) &
			    (ENCRYPTIONFLAGS | COMPRESSIONFLAGS)) != 0U) {
			ret = -ENOTSUP;
		} else if (img_size > sizeof(bitstream)) {
			ret = -EFBIG;
		} else {
			ret = flash_area_read(fa, hdr_size, bitstream, img_size);
		}
	}

	flash_area_close(fa);

	*size = img_size;

	return ret;
}

#else /* File on the SD card */

#include <ff.h>
#include <zephyr/fs/fs.h>

#define MOUNT_POINT "/SD:"

#define BITSTREAM_SOURCE MOUNT_POINT "/" CONFIG_SAMPLE_FPGA_BITSTREAM_FILE_NAME

static FATFS fat_fs;

static struct fs_mount_t fs_mnt = {
	.type = FS_FATFS,
	.fs_data = &fat_fs,
	.mnt_point = MOUNT_POINT,
};

/* Mount the volume and list its root directory. */
static int setup_disk(void)
{
	struct fs_dirent entry;
	struct fs_dir_t dir;
	int ret;

	ret = fs_mount(&fs_mnt);
	if (ret != 0) {
		return ret;
	}

	fs_dir_t_init(&dir);

	ret = fs_opendir(&dir, MOUNT_POINT);
	if (ret != 0) {
		return ret;
	}

	LOG_INF("%s:", MOUNT_POINT);

	while (true) {
		ret = fs_readdir(&dir, &entry);
		if ((ret != 0) || (entry.name[0] == '\0')) {
			break;
		}

		LOG_INF("  %c %zu %s", (entry.type == FS_DIR_ENTRY_FILE) ? 'F' : 'D', entry.size,
			entry.name);
	}

	(void)fs_closedir(&dir);

	return ret;
}

static int bitstream_read(size_t *size)
{
	uint8_t *buf = (uint8_t *)bitstream;
	struct fs_dirent entry;
	struct fs_file_t file;
	size_t pos = 0;
	ssize_t len;
	int ret;

	ret = setup_disk();
	if (ret != 0) {
		return ret;
	}

	ret = fs_stat(BITSTREAM_SOURCE, &entry);
	if (ret != 0) {
		return ret;
	}

	if (entry.size > sizeof(bitstream)) {
		return -EFBIG;
	}

	fs_file_t_init(&file);

	ret = fs_open(&file, BITSTREAM_SOURCE, FS_O_READ);
	if (ret != 0) {
		return ret;
	}

	while (pos < entry.size) {
		len = fs_read(&file, &buf[pos], entry.size - pos);
		if (len <= 0) {
			ret = (len < 0) ? (int)len : -EIO;
			break;
		}

		pos += len;
	}

	(void)fs_close(&file);

	*size = pos;

	return ret;
}

#endif /* CONFIG_SAMPLE_FPGA_BITSTREAM_STORAGE_FLASH */

int main(void)
{
	const struct device *fpga = DEVICE_DT_GET(DT_ALIAS(fpga0));
	size_t size;
	int ret;

	if (!device_is_ready(fpga)) {
		LOG_ERR("FPGA device %s is not ready", fpga->name);
		return 0;
	}

	ret = bitstream_read(&size);
	if (ret != 0) {
		LOG_ERR("Failed to read the bitstream from %s (%d)", BITSTREAM_SOURCE, ret);
		return 0;
	}

	LOG_INF("Read %zu bytes from %s", size, BITSTREAM_SOURCE);

	ret = fpga_load(fpga, bitstream, size);
	if (ret != 0) {
		LOG_ERR("Failed to load the bitstream (%d)", ret);
		return 0;
	}

	LOG_INF("Bitstream loaded, FPGA is %s",
		(fpga_get_status(fpga) == FPGA_STATUS_ACTIVE) ? "active" : "inactive");

	return 0;
}
```
