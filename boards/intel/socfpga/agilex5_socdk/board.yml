## boards/intel/socfpga/agilex5_socdk/board.yml
```yaml
board:
  name: intel_socfpga_agilex5_socdk
  full_name: Agilex™ 5 SoC FPGA Development Kit
  vendor: intel
  socs:
    - name: agilex5
      variants:
        - name: nand
```

## drivers/crypto/Kconfig.altera_fcs
```kconfig
# SPDX-FileCopyrightText: Copyright (c) 2026, Altera Corporation.
# SPDX-License-Identifier: Apache-2.0

config CRYPTO_ALTERA_FCS
	bool "Altera SoC FPGA FCS AES driver"
	default y
	depends on DT_HAS_ALTR_SOCFPGA_SDM_FCS_ENABLED
	depends on ALTERA_SDM
	select CACHE_MANAGEMENT if DCACHE
	help
	  Enable the AES ECB, CBC and CTR driver for the FPGA Crypto Service
	  (FCS) of the Secure Device Manager (SDM) of Altera SoC FPGAs, reached
	  through the SDM mailbox. Keys are imported into the SDM with
	  altera_fcs_import_key() and referenced by key ID.

if CRYPTO_ALTERA_FCS

config CRYPTO_ALTERA_FCS_MAX_SESSION
	int "Maximum number of FCS cipher sessions"
	default 2
	range 1 255
	help
	  Number of cipher sessions the driver can hold at the same time.

config CRYPTO_ALTERA_FCS_BUF_SIZE
	int "FCS data buffer size in bytes"
	default 4096
	range 64 1048576
	help
	  Size of each of the input and output buffers the SDM reads and
	  writes. Longer operations are split into several SDM requests.
	  Must be a multiple of 64.

endif # CRYPTO_ALTERA_FCS
```

## drivers/entropy/Kconfig.altera_sdm
```kconfig
# SPDX-FileCopyrightText: Copyright (c) 2026, Altera Corporation.
# SPDX-License-Identifier: Apache-2.0

config ENTROPY_ALTERA_SDM
	bool "Altera SoC FPGA SDM random number generator"
	default y
	depends on DT_HAS_ALTR_SOCFPGA_SDM_RNG_ENABLED
	depends on ALTERA_SDM
	select ENTROPY_HAS_DRIVER
	help
	  Enable the entropy driver for the random number generator of the
	  Secure Device Manager (SDM) of Altera SoC FPGAs, read through the
	  SDM mailbox. The driver cannot be used from an ISR.

config ENTROPY_ALTERA_SDM_INIT_PRIORITY
	int "Altera SDM random number generator init priority"
	default 61
	depends on ENTROPY_ALTERA_SDM
	help
	  Must be higher (later) than CONFIG_ALTERA_SDM_INIT_PRIORITY, so the
	  SDM is ready when the driver initializes. The driver initializes at
	  the POST_KERNEL level.
```

## drivers/firmware/altera_sdm/Kconfig
```kconfig
# SPDX-FileCopyrightText: Copyright (c) 2026, Altera Corporation.
# SPDX-License-Identifier: Apache-2.0

config ALTERA_SDM
	bool "Altera SoC FPGA Secure Device Manager"
	default y
	depends on DT_HAS_ALTR_SOCFPGA_SDM_ENABLED
	depends on ARM_SIP_SVC_SUBSYS
	depends on ARM_SIP_SVC_HAS_INTEL_SDM_MAILBOX_FIFO
	help
	  Driver for the mailbox of the Secure Device Manager (SDM) of Altera
	  SoC FPGAs, reached through the ARM SiP service. Drivers of devices
	  behind the SDM send mailbox commands through it.

if ALTERA_SDM

config ALTERA_SDM_INIT_PRIORITY
	int "Altera SDM init priority"
	default 60
	help
	  Must be higher (later) than CONFIG_ARM_SIP_SVC_SUBSYS_INIT_PRIORITY,
	  so the SiP service controller is ready when the driver registers
	  its client.

config ALTERA_SDM_TIMEOUT_MS
	int "SDM mailbox timeout in milliseconds"
	default 1000
	help
	  Time to wait for the SiP service client to open and for the SDM to
	  answer a mailbox command.

config HEAP_MEM_POOL_ADD_SIZE_ALTERA_SDM
	int
	default 256
	help
	  The SiP service takes ownership of the mailbox command and response
	  buffers, which are allocated from the system heap.

endif # ALTERA_SDM
```

## drivers/fpga/Kconfig.altera_agilex_bridge
```kconfig
# FPGA ALTERA driver configuration options

# Copyright (c) 2024-2026, Intel Corporation. All rights reserved.
# SPDX-License-Identifier: Apache-2.0

config ALTERA_AGILEX_BRIDGE_FPGA
	bool "Altera/Intel SoCFPGA Agilex FPGA device"
	depends on ARM_SIP_SVC_SUBSYS
	select DEVICE_DEINIT_SUPPORT
	help
	  Zephyr FPGA driver (fpga.h) for Agilex SoC FPGA control (fpga0).
	  on/off: HPS↔FPGA bridge isolation. load/get_status: full fabric
	  programming (partial/freeze not supported yet).
	  Programming code lives in this driver (not a separate shell/subsystem UI).
	  Fabric soft-IP listed in DT soft-ip are init/deinit'd with on/off.

if ALTERA_AGILEX_BRIDGE_FPGA

config FPGA_ALTERA_PROGRAM_THREAD_STACK_SIZE
	int "Altera FPGA program thread stack size"
	default 4096
	help
	  Stack size of the worker thread that runs full FPGA reconfiguration.

endif # ALTERA_AGILEX_BRIDGE_FPGA
```

## drivers/gpio/Kconfig.altera
```kconfig
# Copyright (c) 2023 Intel Corporation
# SPDX-License-Identifier: Apache-2.0

config GPIO_ALTERA_PIO
	bool "Altera PIO"
	default y
	depends on DT_HAS_ALTR_PIO_1_0_ENABLED
	help
	  Enable driver for Altera PIO

if GPIO_ALTERA_PIO

config GPIO_ALTERA_PIO_INIT_PRIORITY
	int "Altera PIO init priority"
	default 76 if ALTERA_AGILEX_BRIDGE_FPGA
	default GPIO_INIT_PRIORITY
	help
	  When PIO nodes are children of fpga0, this must be greater than
	  FPGA_INIT_PRIORITY so DT dependency order passes validation.
	  Fabric PIO should use zephyr,deferred-init; boot still skips
	  their init, but the static priority table must order parent first.

endif # GPIO_ALTERA_PIO
```

## drivers/hwinfo/Kconfig.altera_sdm
```kconfig
# SPDX-FileCopyrightText: Copyright (c) 2026, Altera Corporation.
# SPDX-License-Identifier: Apache-2.0

config HWINFO_ALTERA_SDM
	bool "Altera SoC FPGA SDM device ID"
	default y
	depends on ALTERA_SDM
	select HWINFO_HAS_DRIVER
	help
	  Enable the hwinfo driver reading the 64-bit chip ID of Altera SoC
	  FPGAs from the Secure Device Manager (SDM) mailbox.
```

## drivers/sensor/altera/Kconfig
```kconfig
# SPDX-FileCopyrightText: Copyright (c) 2026, Altera Corporation.
# SPDX-License-Identifier: Apache-2.0

# zephyr-keep-sorted-start
source "drivers/sensor/altera/sdm_hwmon/Kconfig"
# zephyr-keep-sorted-stop
```

## drivers/sensor/altera/sdm_hwmon/Kconfig
```kconfig
# SPDX-FileCopyrightText: Copyright (c) 2026, Altera Corporation.
# SPDX-License-Identifier: Apache-2.0

config ALTERA_SDM_HWMON
	bool "Altera SoC FPGA SDM hardware monitor"
	default y
	depends on DT_HAS_ALTR_SOCFPGA_SDM_HWMON_ENABLED
	depends on ALTERA_SDM
	help
	  Enable the driver for the voltage and temperature sensors of the
	  Secure Device Manager (SDM) of Altera SoC FPGAs, read through the SDM
	  mailbox.
```

## dts/bindings/crypto/altr,socfpga-sdm-fcs.yaml
```yaml
# SPDX-FileCopyrightText: Copyright (c) 2026, Altera Corporation.
# SPDX-License-Identifier: Apache-2.0

description: |
  FPGA Crypto Service (FCS) of the Secure Device Manager (SDM) of Altera SoC
  FPGAs.

  The crypto service is reached with SDM mailbox commands. It has no
  interface of its own, so it is modelled as a child of the
  altr,socfpga-sdm node.

  Example:

    &sdm {
            status = "okay";

            sdm_fcs: fcs {
                    compatible = "altr,socfpga-sdm-fcs";
                    status = "okay";
            };
    };

compatible: "altr,socfpga-sdm-fcs"

include: base.yaml
```

## dts/bindings/firmware/altr,socfpga-sdm.yaml
```yaml
# SPDX-FileCopyrightText: Copyright (c) 2026, Altera Corporation.
# SPDX-License-Identifier: Apache-2.0

description: |
  Secure Device Manager (SDM) of Altera SoC FPGAs.

  The SDM is reached through its mailbox, which EL3 firmware exposes as SiP
  service calls. The node is a child of the SiP service controller node and
  is the parent of the devices whose only interface is the SDM mailbox.

  Example:

    &sip_smc {
            status = "okay";

            sdm: sdm {
                    compatible = "altr,socfpga-sdm";
                    status = "okay";
            };
    };

compatible: "altr,socfpga-sdm"

include: base.yaml
```

## dts/bindings/flash_controller/cdns,nand.yaml
```yaml
# Copyright (c) 2023 Intel Corporation
# SPDX-License-Identifier: Apache-2.0

description: Cadence Nand flash controller

compatible: "cdns,nand"

include: [flash-controller.yaml, reset-device.yaml]

properties:
  data-rate-mode:
    type: int
    required: true
    description: Data Rate mode Selection. 0 - SDR , 1 - NVDDR.
    enum:
      - 0
      - 1

  block-size:
    type: int
    required: true
    description: Erase Block size of Cadence Nand

  clock-frequency:
    type: int
    description: |
      NAND flash controller clock frequency in Hz. Used by
      cadence_setup_data_interface to derive TIMINGS*/PHY values.
      Default 100000000 if omitted.

  cdns,board-delay-ps:
    type: int
    description: |
      Round-trip board delay in picoseconds (U-Boot cdns,board-delay-ps).
      Default 4830 if omitted.
```

## dts/bindings/fpga/altr,socfpga-agilex-bridge.yaml
```yaml
# Copyright (c) 2024-2026, Intel Corporation.
# SPDX-License-Identifier: Apache-2.0

description: |
  Deprecated alias. Use "altr,socfpga-agilex-fpga".
  Kept so existing overlays that still say bridge continue to build.

compatible: "altr,socfpga-agilex-bridge"

include: base.yaml
```

## dts/bindings/fpga/altr,socfpga-agilex-fpga.yaml
```yaml
# Copyright (c) 2024-2026, Intel Corporation.
# SPDX-License-Identifier: Apache-2.0

description: |
  Altera/Intel SoCFPGA Agilex FPGA control device (fpga.h).
  on/off map to HPS↔FPGA bridge isolation (SET_HPS_BRIDGES).
  load/status program the fabric via the FPGA manager (full reconfig only).
  Bitstream staging is DT memory (fpga_config), not this node.

  Fabric soft-IP should be child nodes of this FPGA node (with
  #address-cells/#size-cells/ranges). Status-okay children are
  device_init()'d after bridges are enabled (fpga_on) and
  device_deinit()'d before bridges are isolated (fpga_off).
  Those children should use zephyr,deferred-init.

compatible: "altr,socfpga-agilex-fpga"

include: base.yaml

properties:
  "#address-cells":
    type: int
    const: 1
    description: |
      Required when this node has soft-IP children with reg properties.
  "#size-cells":
    type: int
    const: 1
    description: |
      Required when this node has soft-IP children with reg properties.
```

## dts/bindings/rng/altr,socfpga-sdm-rng.yaml
```yaml
# SPDX-FileCopyrightText: Copyright (c) 2026, Altera Corporation.
# SPDX-License-Identifier: Apache-2.0

description: |
  Random number generator of the Secure Device Manager (SDM) of Altera SoC
  FPGAs.

  The random numbers are read with the SDM mailbox FCS RANDOM_GEN command.
  The generator has no interface of its own, so it is modelled as a child
  of the altr,socfpga-sdm node.

  Example:

    &sdm {
            status = "okay";

            sdm_rng: rng {
                    compatible = "altr,socfpga-sdm-rng";
                    status = "okay";
            };
    };

compatible: "altr,socfpga-sdm-rng"

include: base.yaml
```

## dts/bindings/sensor/altr,socfpga-sdm-hwmon.yaml
```yaml
# SPDX-FileCopyrightText: Copyright (c) 2026, Altera Corporation.
# SPDX-License-Identifier: Apache-2.0

description: |
  Hardware monitor of the Secure Device Manager (SDM) of Altera SoC FPGAs.

  The voltage is read with the SDM mailbox GET_VOLTAGE command and exposed
  as SENSOR_CHAN_VOLTAGE. The temperature is read with the GET_TEMPERATURE
  command and exposed as SENSOR_CHAN_DIE_TEMP. The monitor has no interface
  of its own, so it is modelled as a child of the altr,socfpga-sdm node.

  Example:

    &sdm {
            status = "okay";

            hwmon {
                    compatible = "altr,socfpga-sdm-hwmon";
                    voltage-channel = <2>;
                    temperature-location = <0>;
                    temperature-channel = <0>;
            };
    };

compatible: "altr,socfpga-sdm-hwmon"

include: sensor-device.yaml

properties:
  voltage-channel:
    type: int
    description: |
      SDM voltage channel number, 0 to 15. The channel to rail mapping is
      device specific; see the SDM mailbox documentation of the SoC. Without
      this property SENSOR_CHAN_VOLTAGE is not supported.

  temperature-location:
    type: int
    default: 0
    description: |
      Temperature sensor location, 0 to 65535, passed in bits 15:0 of the
      GET_TEMPERATURE argument. The location numbering is device specific;
      see the SDM mailbox documentation of the SoC.

  temperature-channel:
    type: int
    description: |
      Channel number, 0 to 15, of the sensor at temperature-location, passed
      as a mask in bits 31:16 of the GET_TEMPERATURE argument. Without this
      property the mask is zero.
```

## dts/bindings/sip_svc/intel,socfpga-agilex-sip-smc.yaml
```yaml
# Copyright (c) 2023 Intel Corporation
#
# SPDX-License-Identifier: Apache-2.0

description: SiP SVC driver instance on Intel Agilex SOC FPGA for SMC call

compatible: "intel,socfpga-agilex-sip-smc"

include: base.yaml

properties:
  method:
    type: string
    const: smc
    required: true
    description: |
      The method of calling the EL3 firmware.The current driver only supports
      communication with EL3 firmware.
  shared-memory:
    type: phandle
    description: |
      Phandle to a memory region shared with EL3 firmware. The first half
      holds mailbox commands and the second half holds mailbox responses.
  zephyr,num-clients:
    type: int
    required: true
    description: |
      Number of allowed clients that can communicate with lower layer.
      Maximum allowed is 16.
```

## samples/subsys/shell/shell_module/Kconfig
```kconfig
# Config options for logger sample app

# Copyright (c) 2018 Nordic Semiconductor ASA
# SPDX-License-Identifier: Apache-2.0

mainmenu "Shell module sample application"

menu "Application configuration"

config SHELL_FOREGROUND_CMDS
	bool "Shell foreground commands example"
	default y

config SHELL_DYNAMIC_CMDS
	bool "Shell dynamic commands example"
	default y

choice SHELL_MODULE_STORAGE
	prompt "Storage backend"
	default SHELL_MODULE_STORAGE_NAND if DT_HAS_CDNS_NAND_ENABLED
	default SHELL_MODULE_STORAGE_SDMMC
	help
	  Prefer NAND when Cadence NAND is enabled in DT; otherwise enable
	  the SDMMC disk and filesystem shell stack.

config SHELL_MODULE_STORAGE_NAND
	bool "NAND flash"
	select DISK_ACCESS
	select DISK_DRIVER_FTL if DT_HAS_ZEPHYR_FTL_DHARA_ENABLED && ZEPHYR_DHARA_MODULE
	select FILE_SYSTEM
	select FAT_FILESYSTEM_ELM
	select FILE_SYSTEM_SHELL
	select FILE_SYSTEM_SHELL_MOUNT_COMMAND
	help
	  Use Cadence NAND with Dhara FTL disk (/NAND:) and the FAT
	  filesystem shell. Requires zephyr,ftl-dhara in DT and the
	  dhara west module (west update dhara).

config SHELL_MODULE_STORAGE_SDMMC
	bool "SDMMC"
	select DISK_ACCESS
	select SDHC
	select DISK_DRIVER_SDMMC
	select FILE_SYSTEM
	select FAT_FILESYSTEM_ELM
	select FILE_SYSTEM_SHELL
	select FILE_SYSTEM_SHELL_MOUNT_COMMAND
	help
	  Enable SDMMC disk access and the FAT filesystem shell.

endchoice

endmenu

if SHELL_MODULE_STORAGE_NAND
config FS_FATFS_CUSTOM_MOUNT_POINT_COUNT
	int
	default 1

config FS_FATFS_CUSTOM_MOUNT_POINTS
	string
	default "NAND"
endif

source "Kconfig.zephyr"
```

## subsys/fpga_manager/Kconfig
```kconfig
# FPGA manager configuration option

#Copyright (c) 2023, Intel Corporation.
#SPDX-License-Identifier: Apache-2.0

menuconfig FPGA_MANAGER
	bool "FPGA Manager SUBSYSTEM"
	help
	  Enable support for FPGA MANAGER Subsystem.

if FPGA_MANAGER

module = FPGA_MANAGER
module-str = fpga_manager
source "subsys/logging/Kconfig.template.log_config"

config FPGA_MANAGER_INTEL
	bool "FPGA Manager for Intel devices"
	depends on ARM_SIP_SVC_SUBSYS
	help
	  Enable FPGA Manager support for Intel devices. Registers its own
	  SiP SVC client. Load expects bitstream already in FPGA_CONFIG memory
	  (no filesystem read). Bridge isolation is via fpga_off()/fpga_on() on
	  the Altera Agilex bridge device (when enabled), not inside load.

config FPGA_MANAGER_SHELL
	bool "FPGA Manager shell"
	depends on SHELL
	help
	  Enable FPGA Manager shell support.

config FPGA_MANAGER_THREAD_STACK_SIZE
	int "FPGA Manager thread stack size"
	default 4096
	depends on FPGA_MANAGER_INTEL
	help
	  Stack size of the FPGA Manager thread

endif # FPGA_MANAGER
```
