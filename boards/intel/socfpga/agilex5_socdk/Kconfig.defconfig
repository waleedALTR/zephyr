## boards/intel/socfpga/agilex5_socdk/Kconfig.defconfig
```kconfig
# Copyright (c) 2022-2024 Intel Corporation
# SPDX-License-Identifier: Apache-2.0

config HAS_COVERAGE_SUPPORT
	default y

config MAX_THREAD_BYTES
	default 5

configdefault NOCACHE_MEMORY
	default y

configdefault NET_L2_ETHERNET
	default y

configdefault NET_TX_STACK_SIZE
	default 2048

configdefault NET_RX_STACK_SIZE
	default 2048

configdefault NET_MGMT_EVENT_STACK_SIZE
	default 1024

configdefault NET_SOCKETS_SERVICE_STACK_SIZE
	default 3072

if BOARD_INTEL_SOCFPGA_AGILEX5_SOCDK_AGILEX5_NAND && BOOTLOADER_MCUBOOT

# MCUboot runs from the first MiB of mem0 and loads the application to the
# other 7. Signing takes the load address from zephyr,sram, i.e. mem0.
configdefault SRAM_BASE_ADDRESS
	default 0x80200000

configdefault SRAM_SIZE
	default 7168

configdefault KERNEL_VM_BASE
	default 0x80200000

configdefault KERNEL_VM_SIZE
	default 0x700000

configdefault MCUBOOT_EXTRA_IMGTOOL_ARGS
	default "--load-addr 0x80200000"

endif # BOARD_INTEL_SOCFPGA_AGILEX5_SOCDK_AGILEX5_NAND && BOOTLOADER_MCUBOOT
```

## drivers/fpga/Kconfig
```kconfig
# FPGA driver configuration options

# Copyright (c) 2021-2022 Antmicro <www.antmicro.com>
# SPDX-License-Identifier: Apache-2.0

menuconfig FPGA
	bool "Field-Programmable Gate Array (FPGA) drivers"
	help
	  Enable support for FPGA drivers.

if FPGA

module = FPGA
module-str = fpga
source "subsys/logging/Kconfig.template.log_config"

config FPGA_INIT_PRIORITY
	int "Init priority"
	default 75
	help
	  FPGA device drivers initialization priority

config FPGA_SHELL
	bool "FPGA Shell"
	depends on SHELL && FPGA
	help
	  Enable FPGA Shell support.

config FPGA_SHELL_LOAD_IMAGE
	bool "FPGA Shell command to load an MCUboot image"
	depends on FPGA_SHELL
	depends on FLASH_MAP
	depends on ZEPHYR_MCUBOOT_MODULE
	help
	  Enable the load_image command, which loads a bitstream stored in a
	  flash area behind an MCUboot image header, as written by imgtool.
	  The header layout comes from the MCUboot module; MCUboot itself
	  does not have to be the bootloader.

config FPGA_SHELL_LOAD_IMAGE_MAX_SIZE
	int "Bitstream buffer size of the load_image command"
	default 4194304
	depends on FPGA_SHELL_LOAD_IMAGE
	help
	  Size in bytes of the static buffer the load_image command reads
	  the bitstream into. A larger bitstream is rejected.

source "drivers/fpga/Kconfig.altera_agilex_bridge"
source "drivers/fpga/Kconfig.eos_s3"
source "drivers/fpga/Kconfig.fake"
source "drivers/fpga/Kconfig.ice40"
source "drivers/fpga/Kconfig.mpfs"
source "drivers/fpga/Kconfig.zynqmp"
source "drivers/fpga/Kconfig.slg471x5"

endif # FPGA
```
